## config/boards/shields/Kconfig.shield
```kconfig
config SHIELD_EBE_LEFT
    def_bool $(shields_list_contains,ebe_left)

config SHIELD_EBE_RIGHT
    def_bool $(shields_list_contains,ebe_right)
```

## config/boards/shields/ebe40/Kconfig.shield
```kconfig
config SHIELD_EBE40_LEFT
    def_bool $(shields_list_contains,ebe40_left)

config SHIELD_EBE40_RIGHT
    def_bool $(shields_list_contains,ebe40_right)
```
